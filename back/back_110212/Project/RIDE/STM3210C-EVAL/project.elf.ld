
/*
!!! Primary linker script file generated automatically !!!
This file contains the input and output files names
It also includes the secondary/main linker script that is specified in the Ride options (default or custom)
*/

SEARCH_DIR(".")
SEARCH_DIR("D:\sunny\stm32\therme\Project\RIDE\STM3210C-EVAL")
SEARCH_DIR("C:\Program Files (x86)\Raisonance\Ride\Lib\ARM")
INPUT("D:\sunny\stm32\therme\Project\RIDE\STM3210C-EVAL\main.o")
INPUT("D:\sunny\stm32\therme\Project\RIDE\STM3210C-EVAL\netconf.o")
INPUT("D:\sunny\stm32\therme\Project\RIDE\STM3210C-EVAL\stm32f10x_it.o")
INPUT("D:\sunny\stm32\therme\Project\RIDE\STM3210C-EVAL\stm32f107.o")
INPUT("D:\sunny\stm32\therme\Project\RIDE\STM3210C-EVAL\tftputils.o")
INPUT("D:\sunny\stm32\therme\Project\RIDE\STM3210C-EVAL\client.o")
INPUT("D:\sunny\stm32\therme\Project\RIDE\STM3210C-EVAL\helloworld.o")
INPUT("D:\sunny\stm32\therme\Project\RIDE\STM3210C-EVAL\httpd.o")
INPUT("D:\sunny\stm32\therme\Project\RIDE\STM3210C-EVAL\server.o")
INPUT("D:\sunny\stm32\therme\Project\RIDE\STM3210C-EVAL\tftpserver.o")
INPUT("D:\sunny\stm32\therme\Project\RIDE\STM3210C-EVAL\stm32f10x_i2c.o")
INPUT("D:\sunny\stm32\therme\Project\RIDE\STM3210C-EVAL\stm32f10x_rcc.o")
INPUT("D:\sunny\stm32\therme\Project\RIDE\STM3210C-EVAL\stm32f10x_spi.o")
INPUT("D:\sunny\stm32\therme\Project\RIDE\STM3210C-EVAL\stm32f10x_tim.o")
INPUT("D:\sunny\stm32\therme\Project\RIDE\STM3210C-EVAL\stm32f10x_usart.o")
INPUT("D:\sunny\stm32\therme\Project\RIDE\STM3210C-EVAL\misc.o")
INPUT("D:\sunny\stm32\therme\Project\RIDE\STM3210C-EVAL\stm32f10x_adc.o")
INPUT("D:\sunny\stm32\therme\Project\RIDE\STM3210C-EVAL\stm32f10x_exti.o")
INPUT("D:\sunny\stm32\therme\Project\RIDE\STM3210C-EVAL\stm32f10x_flash.o")
INPUT("D:\sunny\stm32\therme\Project\RIDE\STM3210C-EVAL\stm32f10x_gpio.o")
INPUT("D:\sunny\stm32\therme\Project\RIDE\STM3210C-EVAL\stm32f10x_rtc.o")
INPUT("D:\sunny\stm32\therme\Project\RIDE\STM3210C-EVAL\stm32_eth.o")
INPUT("D:\sunny\stm32\therme\Project\RIDE\STM3210C-EVAL\tcpip.o")
INPUT("D:\sunny\stm32\therme\Project\RIDE\STM3210C-EVAL\api_lib.o")
INPUT("D:\sunny\stm32\therme\Project\RIDE\STM3210C-EVAL\api_msg.o")
INPUT("D:\sunny\stm32\therme\Project\RIDE\STM3210C-EVAL\err.o")
INPUT("D:\sunny\stm32\therme\Project\RIDE\STM3210C-EVAL\netbuf.o")
INPUT("D:\sunny\stm32\therme\Project\RIDE\STM3210C-EVAL\netdb.o")
INPUT("D:\sunny\stm32\therme\Project\RIDE\STM3210C-EVAL\netifapi.o")
INPUT("D:\sunny\stm32\therme\Project\RIDE\STM3210C-EVAL\tcp_out.o")
INPUT("D:\sunny\stm32\therme\Project\RIDE\STM3210C-EVAL\udp.o")
INPUT("D:\sunny\stm32\therme\Project\RIDE\STM3210C-EVAL\dhcp.o")
INPUT("D:\sunny\stm32\therme\Project\RIDE\STM3210C-EVAL\init.o")
INPUT("D:\sunny\stm32\therme\Project\RIDE\STM3210C-EVAL\mem.o")
INPUT("D:\sunny\stm32\therme\Project\RIDE\STM3210C-EVAL\memp.o")
INPUT("D:\sunny\stm32\therme\Project\RIDE\STM3210C-EVAL\netif.o")
INPUT("D:\sunny\stm32\therme\Project\RIDE\STM3210C-EVAL\pbuf.o")
INPUT("D:\sunny\stm32\therme\Project\RIDE\STM3210C-EVAL\raw.o")
INPUT("D:\sunny\stm32\therme\Project\RIDE\STM3210C-EVAL\stats.o")
INPUT("D:\sunny\stm32\therme\Project\RIDE\STM3210C-EVAL\sys.o")
INPUT("D:\sunny\stm32\therme\Project\RIDE\STM3210C-EVAL\tcp.o")
INPUT("D:\sunny\stm32\therme\Project\RIDE\STM3210C-EVAL\tcp_in.o")
INPUT("D:\sunny\stm32\therme\Project\RIDE\STM3210C-EVAL\ethernetif.o")
INPUT("D:\sunny\stm32\therme\Project\RIDE\STM3210C-EVAL\autoip.o")
INPUT("D:\sunny\stm32\therme\Project\RIDE\STM3210C-EVAL\icmp.o")
INPUT("D:\sunny\stm32\therme\Project\RIDE\STM3210C-EVAL\igmp.o")
INPUT("D:\sunny\stm32\therme\Project\RIDE\STM3210C-EVAL\inet.o")
INPUT("D:\sunny\stm32\therme\Project\RIDE\STM3210C-EVAL\inet_chksum.o")
INPUT("D:\sunny\stm32\therme\Project\RIDE\STM3210C-EVAL\ip.o")
INPUT("D:\sunny\stm32\therme\Project\RIDE\STM3210C-EVAL\ip_addr.o")
INPUT("D:\sunny\stm32\therme\Project\RIDE\STM3210C-EVAL\ip_frag.o")
INPUT("D:\sunny\stm32\therme\Project\RIDE\STM3210C-EVAL\etharp.o")
INPUT("D:\sunny\stm32\therme\Project\RIDE\STM3210C-EVAL\def.o")
INPUT("D:\sunny\stm32\therme\Project\RIDE\STM3210C-EVAL\timers.o")
INPUT("D:\sunny\stm32\therme\Project\RIDE\STM3210C-EVAL\ui.o")
INPUT("D:\sunny\stm32\therme\Project\RIDE\STM3210C-EVAL\dir.o")
INPUT("D:\sunny\stm32\therme\Project\RIDE\STM3210C-EVAL\disc.o")
INPUT("D:\sunny\stm32\therme\Project\RIDE\STM3210C-EVAL\efs.o")
INPUT("D:\sunny\stm32\therme\Project\RIDE\STM3210C-EVAL\extract.o")
INPUT("D:\sunny\stm32\therme\Project\RIDE\STM3210C-EVAL\fat.o")
INPUT("D:\sunny\stm32\therme\Project\RIDE\STM3210C-EVAL\file.o")
INPUT("D:\sunny\stm32\therme\Project\RIDE\STM3210C-EVAL\fs.o")
INPUT("D:\sunny\stm32\therme\Project\RIDE\STM3210C-EVAL\ioman.o")
INPUT("D:\sunny\stm32\therme\Project\RIDE\STM3210C-EVAL\ls.o")
INPUT("D:\sunny\stm32\therme\Project\RIDE\STM3210C-EVAL\mkfs.o")
INPUT("D:\sunny\stm32\therme\Project\RIDE\STM3210C-EVAL\partition.o")
INPUT("D:\sunny\stm32\therme\Project\RIDE\STM3210C-EVAL\plibc.o")
INPUT("D:\sunny\stm32\therme\Project\RIDE\STM3210C-EVAL\time.o")
INPUT("D:\sunny\stm32\therme\Project\RIDE\STM3210C-EVAL\sd.o")
INPUT("D:\sunny\stm32\therme\Project\RIDE\STM3210C-EVAL\sd_stm32.o")
INPUT("D:\sunny\stm32\therme\Project\RIDE\STM3210C-EVAL\system_stm32f10x.o")
INPUT("D:\sunny\stm32\therme\Project\RIDE\STM3210C-EVAL\core_cm3.o")
INPUT("D:\sunny\stm32\therme\Project\RIDE\STM3210C-EVAL\startup_stm32f10x_cl.o")
INPUT("D:\sunny\stm32\therme\Project\RIDE\STM3210C-EVAL\stm32_eval.o")
INPUT("D:\sunny\stm32\therme\Project\RIDE\STM3210C-EVAL\et_stm32f_arm_kit_i2c.o")
INPUT("D:\sunny\stm32\therme\Project\RIDE\STM3210C-EVAL\et_stm32f_arm_kit_uart.o")
EXTERN( __io_putchar )
EXTERN( _write )
GROUP(
"STM32x_io_putchar_thumb.a"
"std_sbrk_thumb.lib"
"smallprintf_thumb.a"
"libc.a"
"libm.a"

)
INCLUDE "D:\sunny\stm32\therme\Project\RIDE\STM3210C-EVAL\STM32F107_256K_64K_FLASH.ld"
OUTPUT("D:\sunny\stm32\therme\Project\RIDE\STM3210C-EVAL\project.elf")
